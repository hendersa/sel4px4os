## impl/apps/px4navigator/Kconfig
```kconfig
#
# Copyright 2014, NICTA
#
# This software may be distributed and modified according to the terms of
# the BSD 2-Clause license. Note that NO WARRANTY is provided.
# See "LICENSE_BSD2.txt" for details.
#
# @TAG(NICTA_BSD)
#

config APP_PX4_NAVIGATOR
    bool "PX4 Navigator"
    default y
    depends on LIB_SEL4 && HAVE_LIBC && LIB_REFOS && LIB_UCLIBCPP && LIB_PX4_GEO && LIB_PX4_GEO_LOOKUP && LIB_PX4_CONTROLLIB && LIB_PX4_DATAMAN && LIB_PX4_FW_POS_CONTROL_L1 && LIB_PX4_UORB && LIB_PX4_SYSTEMLIB && LIB_PX4_MATHLIB
    help
        PX4 Navigator module.
```

## impl/apps/px4uorb/Kconfig
```kconfig
#
# Copyright 2014, NICTA
#
# This software may be distributed and modified according to the terms of
# the BSD 2-Clause license. Note that NO WARRANTY is provided.
# See "LICENSE_BSD2.txt" for details.
#
# @TAG(NICTA_BSD)
#

config APP_PX4_UORB
    bool "PX4 uORB"
    default y
    depends on LIB_SEL4 && HAVE_LIBC && LIB_REFOS && LIB_UCLIBCPP
    help
        PX4 uORB service.
```

## impl/libs/Kconfig
```kconfig
#
# Copyright 2014, NICTA
#
# This software may be distributed and modified according to the terms of
# the BSD 2-Clause license. Note that NO WARRANTY is provided.
# See "LICENSE_BSD2.txt" for details.
#
# @TAG(NICTA_BSD)
#

config SEL4_LIBS_PATH
    string
    option env="SEL4_LIBS_PATH"

menu "seL4 Libraries"

source "$SEL4_LIBS_PATH/libsel4/Kconfig"
source "$SEL4_LIBS_PATH/elfloader/Kconfig"
source "$SEL4_LIBS_PATH/libcpio/Kconfig"
source "$SEL4_LIBS_PATH/libdatastruct/Kconfig"
source "$SEL4_LIBS_PATH/libelf/Kconfig"
source "$SEL4_LIBS_PATH/libmuslc/Kconfig"
source "$SEL4_LIBS_PATH/libsel4allocman/Kconfig"
source "$SEL4_LIBS_PATH/libsel4muslcsys/Kconfig"
source "$SEL4_LIBS_PATH/libsel4platsupport/Kconfig"
source "$SEL4_LIBS_PATH/libsel4simple/Kconfig"
source "$SEL4_LIBS_PATH/libsel4simple-stable/Kconfig"

# AWH - Added libuclibc++
source "$SEL4_LIBS_PATH/libuclibc++/Kconfig

source "$SEL4_LIBS_PATH/libsel4utils/Kconfig"
source "$SEL4_LIBS_PATH/libsel4vspace/Kconfig"
source "$SEL4_LIBS_PATH/libsel4vka/Kconfig"
# AWH source "$SEL4_LIBS_PATH/libsel4utils/Kconfig"
source "$SEL4_LIBS_PATH/librefossys/Kconfig"
source "$SEL4_LIBS_PATH/librefos/Kconfig"
source "$SEL4_LIBS_PATH/libutils/Kconfig"
source "$SEL4_LIBS_PATH/libvterm/Kconfig"
source "$SEL4_LIBS_PATH/libplatsupport/Kconfig"

# AWH - Added PX4 libraries
source "$SEL4_LIBS_PATH/libpx4conversion/Kconfig"
source "$SEL4_LIBS_PATH/libpx4mathlib/Kconfig"

endmenu
```

## impl/libs/libpx4compat/Kconfig
```kconfig
#
# Copyright 2014, NICTA
#
# This software may be distributed and modified according to the terms of
# the BSD 2-Clause license. Note that NO WARRANTY is provided.
# See "LICENSE_BSD2.txt" for details.
#
# @TAG(NICTA_BSD)
#

config LIB_PX4_COMPAT
    bool "Build PX4 Compatibility library"
    depends on LIB_SEL4
    default y
    help
        A few functions used to resolve the differences
        among the different versions of libraries used
        for RefOS versus the mainline seL4 kernel. For
        example, __aeabi_atexit(). 
```

## impl/libs/libpx4dataman/Kconfig
```kconfig
#
# Copyright 2014, NICTA
#
# This software may be distributed and modified according to the terms of
# the BSD 2-Clause license. Note that NO WARRANTY is provided.
# See "LICENSE_BSD2.txt" for details.
#
# @TAG(NICTA_BSD)
#

config LIB_PX4_DATAMAN
    bool "Build PX4 Dataman library"
    depends on LIB_SEL4 && HAVE_LIBC && LIB_UCLIBCPP
    default y
    help
        PX4 firmware "dataman" library. 
```

## impl/libs/libpx4drivers/Kconfig
```kconfig
#
# Copyright 2014, NICTA
#
# This software may be distributed and modified according to the terms of
# the BSD 2-Clause license. Note that NO WARRANTY is provided.
# See "LICENSE_BSD2.txt" for details.
#
# @TAG(NICTA_BSD)
#

config LIB_PX4_DRIVERS
    bool "Build PX4 Driver library"
    depends on LIB_SEL4 && HAVE_LIBC && LIB_UCLIBCPP
    default y
    help
        PX4 firmware "driver" library. 
```

## impl/libs/libpx4fw_pos_control_l1/Kconfig
```kconfig
#
# Copyright 2014, NICTA
#
# This software may be distributed and modified according to the terms of
# the BSD 2-Clause license. Note that NO WARRANTY is provided.
# See "LICENSE_BSD2.txt" for details.
#
# @TAG(NICTA_BSD)
#

config LIB_PX4_FW_POS_CONTROL_L1
    bool "Build PX4 FW_Pos_Control_L1 library"
    depends on LIB_SEL4 && HAVE_LIBC && LIB_UCLIBCPP
    default y
    help
        PX4 firmware "fw_pos_control_l1" library. 
```

## impl/libs/libpx4uorb/Kconfig
```kconfig
#
# Copyright 2014, NICTA
#
# This software may be distributed and modified according to the terms of
# the BSD 2-Clause license. Note that NO WARRANTY is provided.
# See "LICENSE_BSD2.txt" for details.
#
# @TAG(NICTA_BSD)
#

config LIB_PX4_UORB
    bool "Build PX4 uORB library"
    depends on LIB_SEL4 && HAVE_LIBC && LIB_UCLIBCPP
    default y
    help
        PX4 firmware "uORB" functionality in a library. 
```
